## build/Kconfig/arch/Kconfig
```kconfig
# Load Zephyr Arch Kconfig descriptions.
osource "/home/aa/ncs/v3.2.2/zephyr/arch/rx/Kconfig"
osource "/home/aa/ncs/v3.2.2/zephyr/arch/x86/Kconfig"
osource "/home/aa/ncs/v3.2.2/zephyr/arch/xtensa/Kconfig"
osource "/home/aa/ncs/v3.2.2/zephyr/arch/sparc/Kconfig"
osource "/home/aa/ncs/v3.2.2/zephyr/arch/riscv/Kconfig"
osource "/home/aa/ncs/v3.2.2/zephyr/arch/posix/Kconfig"
osource "/home/aa/ncs/v3.2.2/zephyr/arch/mips/Kconfig"
osource "/home/aa/ncs/v3.2.2/zephyr/arch/arm64/Kconfig"
osource "/home/aa/ncs/v3.2.2/zephyr/arch/arm/Kconfig"
osource "/home/aa/ncs/v3.2.2/zephyr/arch/arc/Kconfig"
```

## build/Kconfig/boards/Kconfig.sysbuild
```kconfig
# Load Sysbuild board Kconfig descriptions.
osource "/home/aa/ncs/v3.2.2/zephyr/boards/nordic/nrf5340dk/Kconfig.sysbuild"
```

## build/nrf5340_audio/Kconfig/boards/Kconfig.nrf5340dk
```kconfig
# Load board Kconfig descriptions.
osource "/home/aa/ncs/v3.2.2/zephyr/boards/nordic/nrf5340dk/Kconfig.nrf5340dk"
```

## dts/bindings/ti,tas5828.yaml
```yaml
# Copyright (c) 2026
# SPDX-License-Identifier: LicenseRef-Nordic-5-Clause

description: TI TAS5828 class-D audio amplifier

compatible: "ti,tas5828"

include: i2c-device.yaml
```

## sample.yaml
```yaml
sample:
  name: nRF5340 Audio application
  description: LE Audio and Auracast implementation example
tests:
  applications.nrf5340_audio.headset_broadcast_sink_release_usb:
    integration_platforms:
      - nrf5340_audio_dk/nrf5340/cpuapp
      - nrf5340dk/nrf5340/cpuapp
    platform_allow:
      - nrf5340_audio_dk/nrf5340/cpuapp
      - nrf5340dk/nrf5340/cpuapp
    sysbuild: true
    build_only: true
    tags:
      - ci_build
      - sysbuild
      - ci_applications_nrf5340_audio
    extra_args:
      - FILE_SUFFIX=release
      - EXTRA_CONF_FILE=broadcast_sink/overlay-broadcast_sink.conf
  applications.nrf5340_audio.gateway_broadcast_source_release_i2s:
    integration_platforms:
      - nrf5340_audio_dk/nrf5340/cpuapp
      - nrf5340dk/nrf5340/cpuapp
    platform_allow:
      - nrf5340_audio_dk/nrf5340/cpuapp
      - nrf5340dk/nrf5340/cpuapp
    sysbuild: true
    build_only: true
    tags:
      - ci_build
      - sysbuild
      - ci_applications_nrf5340_audio
    extra_args:
      - FILE_SUFFIX=release
      - EXTRA_CONF_FILE=broadcast_source/overlay-broadcast_source.conf
```

## src/control/Kconfig
```kconfig
#
# Copyright (c) 2026
#
# SPDX-License-Identifier: LicenseRef-Nordic-5-Clause
#

menu "Control service"

config CTRL_NVS
	bool "NVS persistence for control parameters"
	select SETTINGS
	help
	  Persists receiver name, volume and mute state via the settings
	  subsystem.

config CTRL_SERVICE
	bool "Auracast Control Service (GATT peripheral)"
	select CTRL_NVS
	select JSON_LIBRARY
	select BT_PERIPHERAL
	help
	  Exposes a GATT custom service (ACS) that accepts JSON commands for
	  volume, mute and name control from a BT Central.

if CTRL_NVS

module = CTRL_NVS
module-str = ctrl_nvs
source "subsys/logging/Kconfig.template.log_config"

endif # CTRL_NVS

if CTRL_SERVICE

module = CTRL_SERVICE
module-str = ctrl_service
source "subsys/logging/Kconfig.template.log_config"

endif # CTRL_SERVICE

config CTRL_CENTRAL
	bool "Auracast Control Central (BT Central manager)"
	select JSON_LIBRARY
	select BT_CENTRAL
	select BT_GATT_CLIENT
	help
	  Scans for sinks that advertise the ACS service UUID, connects via
	  ACL and sends JSON commands over the ACS CMD characteristic.

if CTRL_CENTRAL

config CTRL_CENTRAL_LOG_LEVEL
	int "Log level for ctrl_central"
	default 3

endif # CTRL_CENTRAL

endmenu # Control service
```

## src/drivers/Kconfig
```kconfig
#
# Copyright (c) 2022 Nordic Semiconductor ASA
#
# SPDX-License-Identifier: LicenseRef-Nordic-5-Clause
#

menu "Drivers"

menuconfig NRF5340_AUDIO_CS47L63_DRIVER
	bool "CS47L63 HW codec driver"
	select HW_CODEC_CIRRUS_LOGIC
	help
	  Include the driver for the Cirrus Logic CS47L63 hardware codec chip

if NRF5340_AUDIO_CS47L63_DRIVER

config CS47L63_THREAD_PRIO
	int "Priority for CS47L63 thread"
	default 5
	help
	  This is a preemptible thread

config CS47L63_STACK_SIZE
	int "Stack size for CS47L63"
	default 700

module = CS47L63
module-str = cs47l63
source "subsys/logging/Kconfig.template.log_config"

endif # NRF5340_AUDIO_CS47L63_DRIVER

#----------------------------------------------------------------------------#
menuconfig TAS5828_DRIVER
	bool "TAS5828 amplifier I2C driver"
	depends on I2C
	help
	  Driver for the Texas Instruments TAS5828 class-D amplifier.
	  Controls volume and mute via I2C.

if TAS5828_DRIVER

module = TAS5828
module-str = tas5828
source "subsys/logging/Kconfig.template.log_config"

endif # TAS5828_DRIVER

endmenu # Drivers
```
